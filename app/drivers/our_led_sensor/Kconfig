## boards/aaminu/board.yml
```yaml
board:
  name: aaminu
  full_name: My Board
  vendor: aaminu
  socs:
  - name: rp2040
```

## boards/rahman/Kconfig.rahman
```kconfig
# Copyright (c) 2021 Yonatan Schachter
# SPDX-License-Identifier: Apache-2.0

config BOARD_RAHMAN
	select SOC_RP2040
    select RP2_FLASH_W25Q080
```

## boards/rahman/board.yml
```yaml
board:
  name: rahman
  full_name: My Board From Scratch
  vendor: aaminu
  socs:
  - name: rp2040
```
